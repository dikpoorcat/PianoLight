#include "main.h"

/*全局变量*/
u8 state;



/*******************************************************************************
名称：u8 main(void)
功能： 主函数
入参：
出参：
返回：
*******************************************************************************/
int main(void)
{
	Stm32_Clock_Init(9);														//系统时钟设置
	uart_init(72,115200);														//串口初始化为115200
	delay_init(72);	   	 														//延时初始化 
	WS2812_init();																//LED串初始化
	IWDG_Init(4,625);    														//与分频数为64,重载值为625,溢出时间为1s

	//485初始化
	RCC->APB2ENR|=1<<2;    														//使能PORTA时钟	   	    	 
	GPIOA->CRH&=0XFFFFFFF0; 
	GPIOA->CRH|=0X00000003;														//PA.8 推挽输出   	 

	PAout(8)=0;																	//485接收
	
	state=ZC;																	//上电默认待机状态

	while(1)
	{	
		if(USART_RX_STA & 0x8000)												//若串口接收完成
		{
			LtCmdLightLed(USART_RX_BUF);										//解析协议，灯光控制
			USART_RX_STA = 0;													//清标记与计数
		}
	}
}		
		

/*******************************************************************************
名称：void GuZhang(void)
功能： 故障指示，红色高频闪烁----------------OK
入参：
出参：
返回：
*******************************************************************************/
void GuZhang(void)
{
	CreateArray(255,0,0,0xffffffff,25,&RGB_use0[0][0]);
	Jianruo(&RGB_use0[0][0],20,600);		//400毫秒渐弱50层
}

/*******************************************************************************
名称：void ZanTing(void)
功能： 暂停指示，水绿(0,255,255)-金(250,210,6)高频闪烁----------------OK
入参：
出参：
返回：
*******************************************************************************/
void ZanTing(void)
{
	CreateArray(0,255,255,0x000E00E0,25,&RGB_use0[0][0]);
	CreateArray(250,210,6,0x001F01F0,25,&RGB_use1[0][0]);
	Jianruo2(&RGB_use0[0][0],&RGB_use1[0][0],20,600);		//400毫秒渐弱50层
}

/*******************************************************************************
名称：void DaiJi(void)
功能： 待机指示，水绿(0,255,255)-金(250,210,6)呼吸效果----------------OK
入参：
出参：
返回： 
*******************************************************************************/
void DaiJi(void)
{
	CreateArray(0,255,255,0x01FFFFFF,25,&RGB_use0[0][0]);
	CreateArray(255,255,0,0x01FFFFFF,25,&RGB_use1[0][0]);
//	CreateArray(0x99,0x00,0xff,0x01FFFFFF,&RGB_use1[0][0]);
//	Huxi(&RGB_use1[0][0],80,2000);							//-------------------------------------------------------这里会变绿，
	Huxi2(&RGB_use0[0][0],&RGB_use1[0][0],80,2000);			//400毫秒渐弱50层		
}

/*******************************************************************************
名称：void ZhengChang(void)
功能：正常工作指示，水绿(0,255,255)-金(250,210,6)流水效果----------------OK
入参：
出参：
返回： 
*******************************************************************************/
void ZhengChang(void)
{
	Liushui(0,255,255,250,210,6,12,300);					//LED0/1,300毫秒12LED流水;
}

/*******************************************************************************
名称：void CongDian(void)
功能：充电工作指示，水绿(0,255,255)-金(250,210,6)流水效果----------------OK
入参：
出参：
返回： 
*******************************************************************************/
void CongDian(void)
{
	Jianmang(0,255,255,250,210,6,7,2500);						
//	Jianmang(0,122,122,120,100,6,3,2500);						
}

/********************************************************************
 函 数 名：XOR_check(u8 *buffer, u8 num)
 功    能：异或校验
 说    明：num为要进行XOR运算的字节数
 入口参数：无
 返 回 值：无
 设    计：陈铮                 日    期：2016-5-11
 修    改：                     日    期：
***********************************************************************/
u8 XOR_check(u8 *buffer, u8 num)
{
	u8 i,data;
	data=buffer[0];
	for(i=1;i<num;i++)
	{
		data^=buffer[i];
	}
	return data;
}
